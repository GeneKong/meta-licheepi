## conf/layer.conf
```bitbake
# We have a conf and classes directory, add to BBPATH
BBPATH .= ":${LAYERDIR}"

# We have recipes-* directories, add to BBFILES
BBFILES += "${LAYERDIR}/recipes-*/*/*.bb \
            ${LAYERDIR}/recipes-*/*/*.bbappend"

BBFILE_COLLECTIONS += "meta-licheepi"
BBFILE_PATTERN_meta-licheepi = "^${LAYERDIR}/"
BBFILE_PRIORITY_meta-licheepi = "6"
LAYERSERIES_COMPAT_meta-licheepi = "morty pyro rocko sumo thud"
```

## conf/machine/licheepi-nano.conf
```bitbake
#@TYPE: Machine
#@NAME: nanopi-neo
#@DESCRIPTION: Machine configuration for the FriendlyARM NanoPi Neo, based on the Allwinner H3 CPU

require conf/machine/include/tune-arm926ejs.inc

SOC_FAMILY = "f1c100s"

#PREFERRED_VERSION_u-boot = "v2018.03%"
#KERNEL_DEVICETREE = "sun8i-h3-nanopi-neo.dtb"
#UBOOT_MACHINE = "nanopi_neo_defconfig"

PREFERRED_PROVIDER_virtual/kernel="linux-sunxi"
```
